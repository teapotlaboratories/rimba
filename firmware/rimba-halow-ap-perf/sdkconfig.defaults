## firmware/rimba-halow-ap-perf/sdkconfig.defaults
```kconfig
# rimba-halow-ap app config (layered on top of the board's boards/<BOARD>/ defaults).
# Put the MM6108 driver into AP (SoftAP) mode.
CONFIG_HALOW_AP_MODE=y

# High-STA AP ceiling: accept up to 255 associated stations. Valid AIDs are
# 1..255 now that the S1G TIM spans four PVB blocks (MAX_SUPPORTED_AID=256); 255
# is also the max of the public uint8_t max_stas field.
CONFIG_HALOW_AP_MAX_STAS=255
# Route per-STA umac_sta_data (~912 B each) AND the TWT agreement table to PSRAM,
# not internal SRAM — at 255 STAs that is ~230 KB that must not come from the
# small internal-SRAM pool.
CONFIG_HALOW_STA_DATA_IN_PSRAM=y


# iperf + ping console + the HaLow driver need >1.5MB; use a custom 2MB app partition (16MB flash).
CONFIG_PARTITION_TABLE_CUSTOM=y
CONFIG_PARTITION_TABLE_CUSTOM_FILENAME="partitions.csv"
```

## firmware/rimba-halow-ap/sdkconfig.defaults
```kconfig
# rimba-halow-ap app config (layered on top of the board's boards/<BOARD>/ defaults).
# Put the MM6108 driver into AP (SoftAP) mode.
CONFIG_HALOW_AP_MODE=y

# High-STA AP ceiling: accept up to 100 associated stations. Valid AIDs are
# 1..127 now that the S1G TIM spans two PVB blocks (MAX_SUPPORTED_AID=128).
CONFIG_HALOW_AP_MAX_STAS=100
# Route per-STA umac_sta_data (~912 B each) to PSRAM, not internal SRAM — at 100
# STAs that is ~90 KB that must not come out of the small internal-SRAM pool.
CONFIG_HALOW_STA_DATA_IN_PSRAM=y
```

## firmware/rimba-halow-ibss/sdkconfig.defaults
```kconfig
# rimba-halow-ibss app config (layered on top of the board's boards/<BOARD>/ defaults).
# IBSS reuses the AP-type interface + BSS_CONFIG/beacon code path, so the AP-mode
# morselib sources (umac_ap.c, beacon helpers) must be compiled in.
CONFIG_HALOW_AP_MODE=y
```

## firmware/rimba-halow-mesh-monitor/sdkconfig.defaults
```kconfig
# rimba-halow-monitor app config (layered on top of boards/<BOARD>/ defaults).
# The monitor brings up a mesh vif (mmwlan_mesh_start), which reuses the AP-type
# interface + BSS_CONFIG/beacon code path, so the AP-mode morselib sources must be
# compiled in.
CONFIG_HALOW_AP_MODE=y
```

## firmware/rimba-halow-mesh-perf/sdkconfig.defaults
```kconfig
# rimba-halow-mesh app config (layered on top of boards/<BOARD>/ defaults).
# Mesh (like IBSS) reuses the AP-type interface + BSS_CONFIG/beacon code path,
# so the AP-mode morselib sources must be compiled in.
CONFIG_HALOW_AP_MODE=y

# PERF: 240 MHz on the mains-powered relay/perf board (~1.5x on the CPU-bound crypto).
# Do NOT copy to sleep/STA builds (power).
CONFIG_ESP_DEFAULT_CPU_FREQ_MHZ_240=y
```

## firmware/rimba-halow-scan/sdkconfig.defaults
```kconfig
# ---- Target / console / board (Seeed XIAO ESP32-S3 Plus) ----
CONFIG_IDF_TARGET="esp32s3"
CONFIG_ESP_CONSOLE_USB_SERIAL_JTAG=y
CONFIG_ESP_CONSOLE_SECONDARY_NONE=y

# morselib + the HaLow stack do not fit the default app partition.
CONFIG_PARTITION_TABLE_SINGLE_APP_LARGE=y

# Regulatory domain: mmhalow_init() sets the channel list from this. US =
# 902-928 MHz. Without it the stack reports "Channel list not set" and scan
# fails. Valid: AU CA EU GB IN JP KR NZ US.
CONFIG_HALOW_COUNTRY_CODE="US"

# ---- Morse Micro MM6108 shim: XIAO HaLow wiring ----
# GPIO map from the Seeed XIAO HaLow add-on (Seeed mm-iot-esp32 fork defaults).
# NOTE: the upstream component defaults are a different board (each pin +1), so
# these overrides are required for the XIAO.
CONFIG_MM_RESET_N=1
CONFIG_MM_WAKE=2
CONFIG_MM_BUSY=5
CONFIG_MM_SPI_IRQ=3
CONFIG_MM_SPI_CS=4
CONFIG_MM_SPI_SCK=7
CONFIG_MM_SPI_MISO=8
CONFIG_MM_SPI_MOSI=9

# MM6108 firmware + Board Config File (blobs ship in the morsemicro/firmware
# component). The Seeed XIAO HaLow examples use the MF16858_US module.
# If RF/scan misbehaves, the board may be a Quectel FGH100M-H instead:
# try CONFIG_MM_BCF_FILE="bcf_fgh100mhaamd.mbin".
CONFIG_MMHAL_CHIP_TYPE_MM6108=y
CONFIG_MM_FW_FILE="mm6108.mbin"
CONFIG_MM_BCF_FILE="bcf_mf16858.mbin"
```

## firmware/rimba-hello/sdkconfig.defaults.esp32s3
```kconfig
# Seeed XIAO ESP32-S3 Plus: ESP32-S3R8, 16 MB QIO flash, 8 MB octal (OPI) PSRAM.

# Flash: 16 MB
CONFIG_ESPTOOLPY_FLASHSIZE_16MB=y
CONFIG_ESPTOOLPY_FLASHMODE_QIO=y
CONFIG_ESPTOOLPY_FLASHFREQ_80M=y

# PSRAM: 8 MB octal.
CONFIG_SPIRAM=y
CONFIG_SPIRAM_MODE_OCT=y
CONFIG_SPIRAM_TYPE_AUTO=y
CONFIG_SPIRAM_SPEED_80M=y
```

## firmware/test-apsta-ap/sdkconfig.defaults
```kconfig
# test-apsta-ap needs the MM6108 driver's AP (SoftAP) path compiled in.
# Without this, morselib defines MMWLAN_AP_DISABLED and umac_ap_enable_ap /
# umac_ap_validate_ap_args are absent -> the AP link fails.
CONFIG_HALOW_AP_MODE=y
```

## firmware/test-ibss/sdkconfig.defaults
```kconfig
# IBSS reuses the AP-type interface + BSS_CONFIG/beacon path, so AP-mode morselib sources
# must compile in (same as rimba-halow-ibss / test-mesh-peering).
CONFIG_HALOW_AP_MODE=y
```

## firmware/test-idle/sdkconfig.defaults
```kconfig
# Common defaults for all targets of rimba-hello.
CONFIG_IDF_TARGET="esp32s3"

# Console over the ESP32-S3 native USB-Serial-JTAG (this is what enumerates as
# /dev/ttyACM0 on the XIAO ESP32-S3 — no external USB-UART bridge involved).
CONFIG_ESP_CONSOLE_USB_SERIAL_JTAG=y
CONFIG_ESP_CONSOLE_SECONDARY_NONE=y
```

## firmware/test-mesh-ae/sdkconfig.defaults
```kconfig
# test-mesh-ae app config (layered on top of boards/<BOARD>/ defaults).
CONFIG_HALOW_AP_MODE=y
```

## firmware/test-mesh-gate-fwd/sdkconfig.defaults
```kconfig
# test-mesh-gate-fwd app config (layered on top of boards/<BOARD>/ defaults).
CONFIG_HALOW_AP_MODE=y
```

## firmware/test-mesh-gate-linux/sdkconfig.defaults
```kconfig
# Mesh reuses the AP-type interface + beacon path, so AP-mode morselib sources must compile in.
CONFIG_HALOW_AP_MODE=y
```

## firmware/test-mesh-peering/sdkconfig.defaults
```kconfig
# Mesh reuses the AP-type interface + BSS_CONFIG/beacon path, so the AP-mode
# morselib sources must be compiled in (same as rimba-halow-mesh).
CONFIG_HALOW_AP_MODE=y
```
